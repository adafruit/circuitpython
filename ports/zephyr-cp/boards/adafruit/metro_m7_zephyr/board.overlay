/* No Zephyr console by default, so LPUART1 on D0/D1 is free for busio.UART,
 * as in ports/mimxrt10xx. A CONSOLE=1 build puts the console back on LPUART1
 * (console.overlay). */
/ {
	chosen {
		/delete-property/ zephyr,console;
		/delete-property/ zephyr,shell-uart;
		/delete-property/ zephyr,uart-mcumgr;
	};

	// Named pins that are not on the Arduino header, as in ports/mimxrt10xx.
	// Their names are in circuitpython.toml [connectors.metro_m7_pins].
	metro_m7_pins: metro-m7-pins {
		compatible = "adafruit-metro-m7-pins";
		#gpio-cells = <2>;
		gpio-map-mask = <0xffffffff 0xffffffc0>;
		gpio-map-pass-thru = <0 0x3f>;
		gpio-map = <0 0 &gpio1 20 0>,	/* SCK, GPIO_AD_06 */
			   <1 0 &gpio1 18 0>,	/* MOSI, GPIO_AD_04 */
			   <2 0 &gpio1 17 0>,	/* MISO, GPIO_AD_03 */
			   <3 0 &gpio1 0 0>,	/* NEOPIXEL, GPIO_00 */
			   <4 0 &gpio1 28 0>,	/* SD_CS, GPIO_AD_14 */
			   <5 0 &gpio1 25 0>;	/* SD_CD, GPIO_AD_11 */
	};
};

#include "../../../app.overlay"
