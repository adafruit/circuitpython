/* Applied after board.overlay in CONSOLE=1 and DEBUG=1 builds: the Zephyr
 * console on UART0, fixed to the TX/RX pins. TX/RX are then not available to
 * busio.UART. */
/ {
	chosen {
		zephyr,console = &uart0;
		zephyr,shell-uart = &uart0;
		zephyr,uart-mcumgr = &uart0;
		zephyr,bt-mon-uart = &uart0;
		zephyr,bt-c2h-uart = &uart0;
	};
};

&uart0 {
	/delete-property/ zephyr,deferred-init;
	pinctrl-0 = <&uart0_default>;
	pinctrl-1 = <&uart0_sleep>;
};
