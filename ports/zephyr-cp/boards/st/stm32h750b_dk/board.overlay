&rng {
    status = "okay";
};

/* The USB device controller (zephyr_udc0) and the QSPI flash partition map
 * are defined in the mcuboot fork's dts/st/stm32h750b_dk.dtsi, which
 * sysbuild prepends to this image's overlays. app.overlay only adds the
 * CDC ACM console/data endpoints.
 */
// Enable the SoC watchdog and expose it through the `watchdog0` alias
// (Zephyr's watchdog sample selection) for the watchdog module. The IWDG
// doesn't start on boot (START_ACTIVE_BY_DEFAULT is off); it only arms when
// Python code sets a mode. It cannot be stopped once armed, like the native
// STM32 CircuitPython port.
&iwdg {
	status = "okay";
};

/ {
	aliases {
		watchdog0 = &iwdg;
	};
};

#include "../../../app.overlay"
