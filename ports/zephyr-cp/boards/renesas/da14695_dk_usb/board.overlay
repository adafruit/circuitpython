/* Remove slot1 (OTA), expand slot0 to use the space.
 * CircuitPython doesn't use OTA updates. */
&slot0_partition {
	reg = <0x00010000 DT_SIZE_K(1024)>;
};

/delete-node/ &slot1_partition;

&flash0 {
    partitions{
        circuitpy_partition: partition@118000 {
			compatible = "zephyr,mapped-partition";
			label = "circuitpy";
			reg = <0x118000 (DT_SIZE_M(4) - DT_SIZE_K(1120))>;
		};
    };
};

#include "../../../app.overlay"
