## ports/zephyr-cp/dts/bindings/adafruit-metro-ch32v4x7-pins.yaml
```yaml
# SPDX-FileCopyrightText: 2026 Adafruit Industries
# SPDX-License-Identifier: MIT

description: |
    Named Adafruit Metro CH32V407/CH32V467 pins that are not on its Arduino
    header: the 2x3 SPI header, the NeoPixel, the USER button and the microSD
    card detect.

    The pin names come from the board's circuitpython.toml
    [connectors.<node label>] table, keyed by gpio-map position.

compatible: "adafruit-metro-ch32v4x7-pins"

include: [gpio-nexus.yaml, base.yaml]
```

## ports/zephyr-cp/internal-modules/ch32v4x7_entropy/dts/bindings/rng/adafruit,ch32v4x7-adc-entropy.yaml
```yaml
# SPDX-FileCopyrightText: 2026 Mikey Sklar for Adafruit Industries
# SPDX-License-Identifier: MIT

description: |
  CH32V4x7 entropy source: ADC1 internal temperature sensor noise,
  hashed with SHA-256.

compatible: "adafruit,ch32v4x7-adc-entropy"

include: base.yaml
```
