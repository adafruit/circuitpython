## ports/zephyr-cp/Kconfig.sysbuild
```kconfig
# Copyright 2023-2024 Nordic Semiconductor ASA
# SPDX-License-Identifier: Apache-2.0

# Whether a board boots via Adaboot is declared by the mcuboot fork itself, in
# bootloader/mcuboot/dts/Kconfig.sysbuild (SB_CONFIG_ADABOOT_BOARD).

source "share/sysbuild/Kconfig"

config NET_CORE_BOARD
    string
    default "nrf5340dk/nrf5340/cpunet" if $(BOARD) = "nrf5340dk"
    default "nrf7002dk/nrf5340/cpunet" if $(BOARD) = "nrf7002dk"
    default "nrf5340_audio_dk/nrf5340/cpunet" if $(BOARD) = "nrf5340_audio_dk"
    default "nrf5340bsim/nrf5340/cpunet" if $(BOARD) = "nrf5340bsim"

config NET_CORE_IMAGE_HCI_IPC
    bool "HCI IPC image on network core"
    default y
    depends on NET_CORE_BOARD != ""
```

## ports/zephyr-cp/dts/bindings/adafruit-metro-m7-pins.yaml
```yaml
# SPDX-FileCopyrightText: 2026 Dan Halbert for Adafruit Industries
# SPDX-License-Identifier: MIT

description: |
    Named Adafruit Metro M7 pins that are not on its Arduino header: the 2x3
    SPI header, the NeoPixel, and the microSD or AirLift ESP32 control pins.

    The pin names come from the board's circuitpython.toml
    [connectors.<node label>] table, keyed by gpio-map position, because the
    microSD and AirLift boards name different pins.

compatible: "adafruit-metro-m7-pins"

include: [gpio-nexus.yaml, base.yaml]
```

## ports/zephyr-cp/dts/bindings/circuitpython,spi-loopback.yaml
```yaml
# SPDX-FileCopyrightText: 2026 Vladimir Smitka
# SPDX-License-Identifier: MIT

description: SPI loopback for tests, MOSI wired to MISO

compatible: "circuitpython,spi-loopback"

include: spi-device.yaml
```

## ports/zephyr-cp/internal-modules/pwm_emul/Kconfig
```kconfig
# pwm_emul: emulated PWM controller for native_sim tests.

config PWM_ADAFRUIT_EMUL
	bool "Emulated PWM controller"
	default y
	depends on DT_HAS_ADAFRUIT_PWM_EMUL_ENABLED
	depends on PWM
	help
	  Emulated PWM controller (adafruit,pwm-emul) for native_sim tests. It
	  produces no output; it records the period and pulse each channel is
	  set to and, with Perfetto tracing, emits them as counter tracks.
	  Channel N stands for GPIO N.
```

## ports/zephyr-cp/internal-modules/pwm_emul/dts/bindings/pwm/adafruit,pwm-emul.yaml
```yaml
# SPDX-FileCopyrightText: Copyright (c) 2026 Dan Halbert for Adafruit Industries LLC
# SPDX-License-Identifier: MIT

description: |
  Emulated PWM controller for native_sim tests. It produces no output: it
  records the period and pulse each channel is set to, and with Perfetto
  tracing emits them on the counter tracks "pwm.NN.period" and
  "pwm.NN.pulse". Channel N stands for GPIO N. Only one controller is
  supported.

  Channels that share a period form a group. Any channel can join any
  group, and a group has no channel limit; the number of groups is set by
  the groups property. The driver itself only records settings: CircuitPython's
  iobroker module hands out the groups.

compatible: "adafruit,pwm-emul"

include: [pwm-controller.yaml, base.yaml]

properties:
  channels:
    required: true

  clock-frequency:
    type: int
    required: true
    description: |
      Frequency in Hz that pwm_get_cycles_per_sec() reports; periods and
      pulses are counted in cycles of this clock.

  groups:
    type: int
    required: true
    description: |
      Number of period groups (sets of channels sharing a period) available.

  "#pwm-cells":
    const: 3

pwm-cells:
  - channel
  - period
  - flags
```
